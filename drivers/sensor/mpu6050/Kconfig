## drivers/sensor/mpu6050/Kconfig
```kconfig
config MPU6050_CUSTOM
    bool "Custom MPU6050 sensor driver"
    default y
    depends on I2C
    select SENSOR
    help
      Enable a custom MPU6050 driver using Zephyr's Sensor API.
```
